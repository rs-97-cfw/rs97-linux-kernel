## drivers/video/hdmi/Kconfig
```kconfig
choice
	depends on JZ4760_HDMI_DISPLAY 
	prompt  "HDMI Chip Select"
config HDMI_NULL
	bool "NULL"
config HDMI_IT6610
	bool "HDMI IT6610"
config HDMI_IT6610_OLD
	bool "HDMI IT6610 OLD"
#config HDMI_EP932
#	bool "HDMI EP932"
endchoice
```
